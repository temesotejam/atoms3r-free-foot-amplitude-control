#pragma once
#include <Arduino.h>
#include <cstring>

// Stopped-export only. Preserve JSON values exactly, storing column names once.
// Input objects are generated by our serializers; reject any schema drift.
template<class Output> class CompactJsonTable {
 public:
  explicit CompactJsonTable(Output& out):out_(out) {}
  bool append(const String& object) {
    String fields, values;
    const char* p=object.c_str();
    if (*p++!='{') return ok_=false;
    while (*p && *p!='}') {
      if (*p!='"') return ok_=false;
      const char* key=p++;
      while (*p && *p!='"') { if (*p=='\\' && p[1]) ++p; ++p; }
      if (!*p) return ok_=false;
      ++p;
      if (fields.length()) fields+=",";
      range(fields,key,p-key);
      if (*p++!=':') return ok_=false;
      const char* value=p;
      int depth=0; bool quoted=false,escaped=false;
      for (;*p;++p) {
        const char c=*p;
        if (quoted) {
          if (escaped) escaped=false;
          else if (c=='\\') escaped=true;
          else if (c=='"') quoted=false;
        } else {
          if (c=='"') quoted=true;
          else if (c=='[' || c=='{') ++depth;
          else if (c==']' || c=='}') { if (depth==0) break; --depth; }
          else if (c==',' && depth==0) break;
        }
      }
      if (p==value || quoted || depth || !*p) return ok_=false;
      if (values.length()) values+=",";
      range(values,value,p-value);
      if (*p==',') ++p;
    }
    if (*p!='}' || p[1]) return ok_=false;
    if (!started_) {
      fields_=fields;
      out_+="{\"fields\":["; out_+=fields_; out_+="],\"rows\":[";
      started_=true;
    } else {
      if (strcmp(fields.c_str(),fields_.c_str())) return ok_=false;
      out_+=",";
    }
    out_+="["; out_+=values; out_+="]";
    return ok_;
  }
  bool finish() {
    out_+=started_?"]}":"{\"fields\":[],\"rows\":[]}";
    return ok_;
  }
 private:
  static void range(String& out,const char* p,size_t size) {
    char buffer[128];
    while (size) {
      const size_t n=size<sizeof(buffer)-1?size:sizeof(buffer)-1;
      memcpy(buffer,p,n); buffer[n]=0; out+=buffer; p+=n; size-=n;
    }
  }
  Output& out_;
  String fields_;
  bool started_=false,ok_=true;
};
